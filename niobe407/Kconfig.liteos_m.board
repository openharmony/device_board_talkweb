## niobe407/Kconfig.liteos_m.board
```kconfig
# Copyright (c) 2021-2022 Talkweb Co., Ltd.
# Licensed under the Apache License, Version 2.0 (the "License");
# you may not use this file except in compliance with the License.
# You may obtain a copy of the License at
#
#     http://www.apache.org/licenses/LICENSE-2.0
#
# Unless required by applicable law or agreed to in writing, software
# distributed under the License is distributed on an "AS IS" BASIS,
# WITHOUT WARRANTIES OR CONDITIONS OF ANY KIND, either express or implied.
# See the License for the specific language governing permissions and
# limitations under the License.

menuconfig BOARD_NIOBE407
    bool "select board niobe407"
    depends on SOC_STM32F407

orsource "liteos_m/hdf_config/Kconfig.liteos_m.board"
orsource "../../../../vendor/talkweb/niobe407/demo/Kconfig.board.applications"
```
